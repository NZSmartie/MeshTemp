## boards/arm/xiaomi_bt_sensor/Kconfig.board
```kconfig
# Kconfig - nRF51-VBLUNO51 board configuration
#
# Copyright (c) 2017 VNG IoT Lab Limited.
#
# SPDX-License-Identifier: Apache-2.0

config BOARD_NRF51_XIAOMI_BT_SENSOR
	bool "nRF51 Xiaomi Bluetooth Sensor"
	depends on SOC_NRF51822_QFAA
```

## boards/arm/xiaomi_bt_sensor/Kconfig.defconfig
```kconfig
if BOARD_NRF51_XIAOMI_BT_SENSOR

config BOARD
	default "nrf51_xiaomi_bt_sensor"

config BT_CTLR
	default BT

endif # BOARD_NRF51_XIAOMI_BT_SENSOR
```

## boards/arm/xiaomi_bt_sensor/xiaomi_bt_sensor_defconfig
```kconfig
# SPDX-License-Identifier: Apache-2.0

CONFIG_SOC_SERIES_NRF51X=y
CONFIG_SOC_NRF51822_QFAA=y
CONFIG_BOARD_NRF51_XIAOMI_BT_SENSOR=y

# Use internal RC for 32KHz clock source
CONFIG_CLOCK_CONTROL_NRF_K32SRC_RC=y

# enable GPIO
CONFIG_GPIO=y

#enable I2C
CONFIG_I2C=y
CONFIG_I2C_1=y
CONFIG_I2C_1_NRF_TWI=y

#enable SPI
CONFIG_SPI=y
CONFIG_SPI_0=y
CONFIG_SPI_0_NRF_SPI=y

CONFIG_ADC=y
CONFIG_ADC_0=y

# enable the segment display driver
CONFIG_BU9795=y

# enable the temperature and humidity sensor
CONFIG_SENSOR=y
CONFIG_SHT3XD=y

# enable uart driver
CONFIG_SERIAL=y
CONFIG_UART_0_NRF_UART=y

# enable console
CONFIG_CONSOLE=y
CONFIG_UART_CONSOLE=y
```

## boards/arm/xiaomi_bt_sensor_mod/Kconfig.defconfig
```kconfig
if BOARD_NRF51_XIAOMI_BT_SENSOR_MOD

config BOARD
	default "nrf51_xiaomi_bt_sensor_mod"

if I2C

config I2C_0
	default y

endif # I2C

config BT_CTLR
	default BT

endif
```

## boards/arm/xiaomi_bt_sensor_mod/xiaomi_bt_sensor_mod_defconfig
```kconfig
# SPDX-License-Identifier: Apache-2.0

CONFIG_ARM=y
CONFIG_SOC_FAMILY_NRF=y
CONFIG_SOC_SERIES_NRF51X=y
CONFIG_SOC_NRF51822_QFAC=y
CONFIG_BOARD_NRF51_XIAOMI_BT_SENSOR_MOD=y

# enable GPIO
CONFIG_GPIO=y

# enable uart driver
CONFIG_SERIAL=n
CONFIG_UART_0_NRF_UART=n

# enable console
CONFIG_CONSOLE=n
CONFIG_UART_CONSOLE=n
```

## drivers/BU9795/zephyr/Kconfig
```kconfig
menuconfig BU9795
	depends on SPI
	bool "Rohm BU9795 LCD segment drivers"

if BU9795

config BU9795_TEST_PATTERN
	depends on BU9795
	bool "Enable test pattern API"

module = BU9795
module-str = BU9795
source "subsys/logging/Kconfig.template.log_config"

endif # BU9795
```

## drivers/BU9795/zephyr/dts/bindings/rohm,bu9795.yaml
```yaml
description: BU97975 Standard LCD Segment Driver

compatible: "rohm,bu9795"

include: spi-device.yaml
```
